## Kconfig
```kconfig
menu "esp-seq Application Configuration"
    config APP_FORCE_LAUNCHPAD
        bool
        default n
        help
            Force app to use the launchpad controller

    config APP_DUMP_PERIPHERALS
        bool
        default n
        help
            Dump peripheral data (midi and output) to serial port
endmenu
```

## components/output/Kconfig
```kconfig
menu "Output Configuration"
    config OUTPUT_DUMP_VOLTAGES
        bool "Dump voltages"
        default n
        help
            Print output voltages to the standard console.

endmenu
```

## main/Kconfig
```kconfig
menu "esp-seq"
    # include relative sub components
    rsource "../components/*/Kconfig"

    config ESPSEQ_DUMP_ALL
        bool "Dump all data"
        default n
        select ESPSEQ_DUMP_MIDI
        select OUTPUT_DUMP_VOLTAGES
        help
            Dump various data to the default console.

    config ESPSEQ_DUMP_MIDI
        bool "Dump midi data"
        default n
        help
            Dump midi data to the default console.

    config ESPSEQ_USB_MIDI_ENABLE
        bool "Enable USB Midi Interface"
        default y
        depends on !ESP_CONSOLE_USB_CDC # cannot enable usb midi if used as console output
        help
            Enable USB Midi Interface.

    config ESPSEQ_FORCE_LAUNCHPAD
        bool "Force Launchpad"
        default n
        help
            Force app to use the Launchpad controller.

endmenu
```

## sdkconfig.defaults
```kconfig
# application specific settings

# default log levels
CONFIG_BOOTLOADER_LOG_LEVEL_VERBOSE=y
CONFIG_LOG_DEFAULT_LEVEL_INFO=y

# flash via UART requires no stub and manual reset
CONFIG_ESPTOOLPY_NO_STUB=y
CONFIG_ESPTOOLPY_BEFORE_NORESET=y
CONFIG_ESPTOOLPY_AFTER_NORESET=y

# usb settings
CONFIG_ESP32S2_KEEP_USB_ALIVE=y
CONFIG_ESP_PHY_ENABLE_USB=y

# console output settings
CONFIG_ESP_CONSOLE_USB_CDC=y
CONFIG_ESP_CONSOLE_USB_CDC_RX_BUF_SIZE=64
CONFIG_ESP_CONSOLE_USB_CDC_SUPPORT_ETS_PRINTF=y
CONFIG_ESP_CONSOLE_UART_NUM=-1

# panic handling
CONFIG_ESP_SYSTEM_PANIC_PRINT_HALT=y

# freertos settings
CONFIG_FREERTOS_USE_TRACE_FACILITY=y
```
